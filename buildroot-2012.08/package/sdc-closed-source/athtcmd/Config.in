## buildroot-2012.08/package/sdc/Config.in
```kconfig
source "package/sdc/macplus1/Config.in"
source "package/sdc/patchram/Config.in"
source "package/sdc/libedit/Config.in"
source "package/sdc/wifireset/Config.in"
source "package/sdc/sdcbins/Config.in"
source "package/sdc/wbfs/Config.in"
```

## buildroot-2012.08/package/sdc/macplus1/Config.in
```kconfig
config BR2_PACKAGE_MACPLUS1
	bool "MAC PLUS ONE"
	help
	  Increments a MAC address by 1.
```

## buildroot-2012.08/package/sdc/wbfs/Config.in
```kconfig
config BR2_PACKAGE_WBFS
	bool "WB Platform Filesystem"
	default y
	help
	  Customizes a wb-platform's rootfs.

	  A tree of common files will be copied to the output/target rootfs, in
	  addition to the fs/skeleton files.

	  Depending on the string value of env variable WB_PLATFORM, also add a
	  matching tree <directory-name> of specific files to the rootfs.
	  And if a matching <script-name>.sh is found, will source it.
```

## buildroot/board/sdc/Config.in
```kconfig
menu "Laird"

    choice
        prompt "Board"

        config BR2_SDC_PLATFORM_WB45N
            bool "WB45N"

        config BR2_SDC_PLATFORM_WB40N
            bool "WB40N"
    endchoice

    config BR2_SDC_PLATFORM
        string
        default "wb45n"   if BR2_SDC_PLATFORM_WB45N
        default "wb40n"   if BR2_SDC_PLATFORM_WB40N

    menu "Packages"
        source "package/sdc/Config.in"
    endmenu

    menu "Packages (Closed Source)"
        source "package/sdc-closed-source/Config.in"
    endmenu

    menu "Customers"
        source "board/sdc/customers/Config.in"
    endmenu
	
endmenu
```

## buildroot/board/sdc/customers/carefusion/Config.in
```kconfig
menu "Carefusion"
source "board/sdc/customers/carefusion/ncm-package/Config.in"
endmenu
```

## buildroot/package/sdc-closed-source/Config.in
```kconfig
source "package/sdc-closed-source/sdcsdk/Config.in"
source "package/sdc-closed-source/sdccli/Config.in"
source "package/sdc-closed-source/sdcsupp/Config.in"
source "package/sdc-closed-source/libtcmd/Config.in"
source "package/sdc-closed-source/athtcmd/Config.in"
source "package/sdc-closed-source/dhd/Config.in"
source "package/sdc-closed-source/sdc2u/Config.in"
source "package/sdc-closed-source/ar6kl-tools-v311/Config.in"
source "package/sdc-closed-source/ar6kl-tools/Config.in"
source "package/sdc-closed-source/wmiconfig/Config.in"
```

## buildroot/package/sdc-closed-source/ar6kl-tools/Config.in
```kconfig
config BR2_PACKAGE_AR6KL_TOOLS
	bool "Ar6kl Tools (dbgParser)"
	help
	  Ar6kl Tools
```

## buildroot/package/sdc-closed-source/sdc2u/Config.in
```kconfig
config BR2_PACKAGE_SDC2U
    select BR2_LINUX_KERNEL
    select BR2_PACKAGE_OPENSSL
	bool "SDC2U DRIVER FOR CCMP_FIPS"
	help
	  Builds sdc2u.ko extra driver and sdcu app for ccmp_fips on the wb45n.
	  The ath6kl driver is modified and fips enabled firmware is required.

if BR2_PACKAGE_SDC2U

config BR2_PACKAGE_SDC2U_PULL_FROM_SVN
	bool "Pull source code from subversion"
	help
	  Pull source code from subversion

if BR2_PACKAGE_SDC2U_PULL_FROM_SVN

config BR2_PACKAGE_SDC2U_SVN_VERSION
	string "Svn revision/label to pull"
	help
	  Svn revision/label to pull

endif

endif
```

## buildroot/package/sdc-closed-source/sdc2u_fips/Config.in
```kconfig
config BR2_PACKAGE_SDC2U
	bool "CCMP_FIPS SDC2U driver and SDCU app"
	help
	  SDC2U driver
```

## buildroot/package/sdc-closed-source/sdcbins-packager/Config.in
```kconfig
config BR2_PACKAGE_SDCBINS_PACKAGER
	bool "SDC Binaries Packager"
	help
      Collects all the SDC Binaries artefacts (sdcsupp, sdcsdk, sdc_cli, etc)
	  into a tarball and installs the tarball into the archive directory so
	  that it can used by the sdcbins package.

if BR2_PACKAGE_SDCBINS_PACKAGER

config BR2_SDCBINS_PACKAGER_VERSION
	string "SDC/Laird Binaries version"
	help
	  Specify the version to produce.
	  E.g. svn18163-25jan13.

endif
```

## buildroot/package/sdc/Config.in
```kconfig
source "package/sdc/patchram/Config.in"
source "package/sdc/libedit/Config.in"
source "package/sdc/msd45n-binaries/Config.in"
source "package/sdc/msd40n-binaries/Config.in"
source "package/sdc/openssl-fips/Config.in"
source "package/sdc/mc-mint/Config.in"
source "package/sdc/php/Config.in"
```

## buildroot/package/sdc/sdcbins/Config.in
```kconfig
config BR2_PACKAGE_SDCBINS
	bool "SDC Binaries"
	help
      SDC Binaries artefacts (sdcsupp, sdcsdk, sdc_cli, etc)

if BR2_PACKAGE_SDCBINS

config BR2_SDCBINS_VERSION
	string "SDC/Laird Binaries version"
	help
	  Specify the version of sdcbins to use.
	  E.g. svn18163-25jan13.

endif
```
